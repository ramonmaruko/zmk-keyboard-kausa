/*
 * Copyright (c) 2024 Nordic Semiconductor ASA
 *
 * SPDX-License-Identifier: Apache-2.0
 */

#include "kausa_nrf54l_05_10_15-pinctrl.dtsi"

/ {
	aliases {
		watchdog0 = &wdt31;
	};
};

/* Get a node label for wi-fi spi to use in shield files */

&uicr {
	nfct-pins-as-gpios;
};

wifi_spi: &spi22 {};
