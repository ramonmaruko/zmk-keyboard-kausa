## boards/ramonmaruko/kausa/Kconfig.defconfig
```kconfig
if BOARD_KAUSA_LEFT

config ZMK_KEYBOARD_NAME
    default "Kausa"

config ZMK_SPLIT_ROLE_CENTRAL
    default y

endif # BOARD_KAUSA_LEFT


if BOARD_KAUSA_LEFT || BOARD_KAUSA_RIGHT

config BOARD
    default "kausa"

config ZMK_SPLIT
    default y


config HW_STACK_PROTECTION
	default ARCH_HAS_STACK_PROTECTION

if SPI_NOR

config SPI_NOR_FLASH_LAYOUT_PAGE_SIZE
	default 4096 if MCUBOOT || BOOTLOADER_MCUBOOT

endif # SPI_NOR

endif # BOARD_KAUSA_LEFT || BOARD_KAUSA_RIGHT
```

## boards/ramonmaruko/kausa/Kconfig.kausa
```kconfig
# Copyright (c) 2024 Nordic Semiconductor ASA
# SPDX-License-Identifier: Apache-2.0

config BOARD_KAUSA
	select SOC_NRF54L15_CPUAPP if BOARD_KAUSA_NRF54L15_CPUAPP || \
		BOARD_KAUSA_NRF54L15_CPUAPP_LEFT || \
		BOARD_KAUSA_NRF54L15_CPUAPP_RIGHT || \
		BOARD_KAUSA_NRF54L15_CPUAPP_NS
	select SOC_NRF54L15_CPUFLPR if BOARD_KAUSA_NRF54L15_CPUFLPR || \
					    BOARD_KAUSA_NRF54L15_CPUFLPR_XIP
```

## boards/ramonmaruko/kausa/Kconfig.kausa_left
```kconfig
config BOARD_KAUSA_LEFT
	select SOC_NRF54L15_CPUAPP if BOARD_KAUSA_LEFT_NRF54L15_CPUAPP_ZMK
	select ZMK_BOARD_COMPAT
	select BOARD_LATE_INIT_HOOK
	imply RETAINED_MEM
	imply RETENTION
	imply RETENTION_BOOT_MODE
```

## boards/ramonmaruko/kausa/Kconfig.kausa_right
```kconfig
config BOARD_KAUSA_RIGHT
	select SOC_NRF54L15_CPUAPP if BOARD_KAUSA_RIGHT_NRF54L15_CPUAPP_ZMK
	select ZMK_BOARD_COMPAT
	select BOARD_LATE_INIT_HOOK
	imply RETAINED_MEM
	imply RETENTION
	imply RETENTION_BOOT_MODE
```

## boards/ramonmaruko/kausa/board.yml
```yaml
boards:
  - name: kausa_left
    full_name: Kausa (Left)
    vendor: ramonmaruko
    socs:
      - name: nrf54l15
        variants:
          - name: zmk
            cpucluster: cpuapp
  - name: kausa_right
    full_name: Kausa (Right)
    vendor: ramonmaruko
    socs:
      - name: nrf54l15
        variants:
          - name: zmk
            cpucluster: cpuapp

runners:
  run_once:
    '--recover':
      - runners:
          - nrfjprog
          - nrfutil
        run: first
        groups:
          - boards:
              - kausa_left/nrf54l15/cpuapp/zmk
              - kausa_right/nrf54l15/cpuapp/zmk
    '--erase':
      - runners:
          - nrfjprog
          - jlink
          - nrfutil
        run: first
        groups:
          - boards:
              - kausa_left/nrf54l15/cpuapp/zmk
              - kausa_right/nrf54l15/cpuapp/zmk
    '--reset':
      - runners:
          - nrfjprog
          - jlink
          - nrfutil
        run: last
        groups:
          - boards:
              - kausa_left/nrf54l15/cpuapp/zmk
              - kausa_right/nrf54l15/cpuapp/zmk
```

## boards/ramonmaruko/kausa/kausa_left_nrf54l15_cpuapp_zmk_defconfig
```kconfig
CONFIG_GPIO=y
CONFIG_ARM_MPU=y

CONFIG_ZMK_BLE=y

CONFIG_MPU_ALLOW_FLASH_WRITE=y
CONFIG_ZMS=y
CONFIG_SETTINGS_ZMS=y
CONFIG_FLASH=y
CONFIG_FLASH_PAGE_LAYOUT=y
CONFIG_FLASH_MAP=y

# Only for the central
CONFIG_BT_RX_STACK_SIZE=2048
# debug stack overflows
CONFIG_THREAD_NAME=y

#CONFIG_USE_SEGGER_RTT=y
#CONFIG_RTT_CONSOLE=y
#CONFIG_UART_CONSOLE=n
```

## boards/ramonmaruko/kausa/kausa_nrf54l15_cpuapp_defconfig
```kconfig
# Copyright (c) 2024 Nordic Semiconductor ASA
# SPDX-License-Identifier: Apache-2.0

CONFIG_INPUT=y
CONFIG_INPUT_SHELL=y
CONFIG_INPUT_SHELL_KBD_MATRIX_STATE=y
#CONFIG_INPUT_LOG_LEVEL_DBG=y

# Enable UART driver
CONFIG_SERIAL=y

# Enable GPIO
CONFIG_GPIO=y
CONFIG_GPIO_SHELL=y

# Enable MPU
CONFIG_ARM_MPU=y

# Enable console
CONFIG_CONSOLE=y
CONFIG_USE_SEGGER_RTT=y
CONFIG_RTT_CONSOLE=y
CONFIG_UART_CONSOLE=n

CONFIG_SHELL=y
CONFIG_SHELL_BACKEND_RTT=y
CONFIG_SHELL_BACKEND_SERIAL=n

CONFIG_LOG=y
CONFIG_LOG_BUFFER_SIZE=10240
# CONFIG_LOG_BACKEND_RTT=y

CONFIG_REGULATOR=y
CONFIG_REGULATOR_SHELL=y

CONFIG_I2C_SHELL=y
CONFIG_I2C_LOG_LEVEL_DBG=y
```

## boards/ramonmaruko/kausa/kausa_right_nrf54l15_cpuapp_zmk_defconfig
```kconfig
CONFIG_GPIO=y
CONFIG_ARM_MPU=y

CONFIG_ZMK_BLE=y

CONFIG_MPU_ALLOW_FLASH_WRITE=y
CONFIG_ZMS=y
CONFIG_SETTINGS_ZMS=y
CONFIG_FLASH=y
CONFIG_FLASH_PAGE_LAYOUT=y
CONFIG_FLASH_MAP=y

#CONFIG_USE_SEGGER_RTT=y
#CONFIG_RTT_CONSOLE=y
#CONFIG_UART_CONSOLE=n

CONFIG_NRF_FUEL_GAUGE=y
CONFIG_NRF_FUEL_GAUGE_VARIANT_SECONDARY_CELL=y

# For ZMK battery reporting
CONFIG_ZMK_LOW_PRIORITY_THREAD_STACK_SIZE=2048
CONFIG_ZMK_BATTERY_REPORT_INTERVAL=1
CONFIG_ZMK_SPLIT_BLE_CENTRAL_BATTERY_LEVEL_FETCHING=y
```

## west.yml
```yaml
manifest:
  remotes:
    - name: urob
      url-base: https://github.com/urob
    - name: nrfconnect
      url-base: https://github.com/nrfconnect
  projects:
    - name: zmk-auto-layer
      remote: urob
      revision: main
    - name: sdk-nrfxlib
      remote: nrfconnect
      repo-path: sdk-nrfxlib
      revision: main
```
