/*
 * Copyright (c) 2024 Nordic Semiconductor ASA
 *
 * SPDX-License-Identifier: Apache-2.0
 */

/dts-v1/;

#include <nordic/nrf54l15_cpuapp.dtsi>
#include "kausa_nrf54l15_cpuapp_common.dtsi"
#include <dt-bindings/zmk/matrix_transform.h>


/ {
	compatible = "ramonmaruko,kausa_nrf54l15-cpuapp";
	model = "ramonmaruko Kausa nRF54L15 Application MCU";

	chosen {
		zephyr,code-partition = &slot0_partition;
		zephyr,sram = &cpuapp_sram;
	};

};

/* Include default memory partition configuration file */
#include "nrf54l15_partition.dtsi"
