#include <dt-bindings/zmk/matrix_transform.h>
#include <layouts/kausa-layouts.dtsi>
#include <transforms/kausa-transforms.dtsi>

&physical_layout0 {
       transform = <&default_transform>;
};

/ {
    chosen {
        zmk,matrix-input = &mock_matrix_input;
    };

    mock_matrix_input: mock_matrix_input {
        compatible = "zmk,input-matrix-mock";
	columns = <0>;
	rows = <0>;
	events = <0>;
    };
};

